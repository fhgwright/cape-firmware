/*
 * Setup to enable output pin for timer7 (P8.8)
 */
/dts-v1/;
/plugin/;

/ {
	compatible = "ti,beaglebone", "ti,beaglebone-black";

        /* identification */
        part-number = "BBB_TIMER7OUT";
        version = "00A0";

        /* state the resources this cape uses */
        exclusive-use =
                /* the pin header uses */
                "P8.8",         /* timer7 pin */
                /* the hardware ip uses */
		"timer7";  /* 0-based counting */

        fragment@0 {
                target = <&am33xx_pinmux>;
                __overlay__ {
                        timer7_pins: pinmux_timer7_pins {
				pinctrl-single,pins = <
				      0x94 0x0A /* P8.8 MODE2 TIMER7 OUT */
				>;
			};
                };
        };
};
